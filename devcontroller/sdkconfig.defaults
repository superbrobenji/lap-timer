## main/Kconfig.projbuild
```kconfig
menu "LapTimer"

    choice LAPTIMER_VARIANT
        prompt "Vehicle variant"
        default LAPTIMER_VARIANT_MOTO
        help
            Vehicle variant. Selected by build.sh via -D VARIANT=<moto|car>
            (through the per-variant sdkconfig fragment) and kept here for
            menuconfig visibility only. The authoritative compile-time switch
            is build_config.h (CFG_VARIANT_*), generated from the build flags
            (spec §21.2).

        config LAPTIMER_VARIANT_MOTO
            bool "moto (motorcycle)"

        config LAPTIMER_VARIANT_CAR
            bool "car"
    endchoice

endmenu
```

## test_apps/core_selftest/sdkconfig.defaults
```kconfig
CONFIG_IDF_TARGET="esp32"
CONFIG_ESPTOOLPY_FLASHSIZE_4MB=y
CONFIG_ESP_MAIN_TASK_STACK_SIZE=40960
CONFIG_ESP_MAIN_TASK_AFFINITY_CPU0=y
CONFIG_ESP_TASK_WDT_EN=n
CONFIG_ESP_INT_WDT=y
CONFIG_FREERTOS_HZ=1000
CONFIG_PTHREAD_TASK_STACK_SIZE_DEFAULT=6144
CONFIG_COMPILER_STACK_CHECK_MODE_STRONG=y
CONFIG_COMPILER_OPTIMIZATION_DEFAULT=y
```
